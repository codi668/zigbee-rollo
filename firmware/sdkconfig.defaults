## tools/sniffer/sdkconfig.defaults
```kconfig
CONFIG_IDF_TARGET="esp32h2"
CONFIG_ESP_CONSOLE_USB_SERIAL_JTAG=y
CONFIG_LOG_DEFAULT_LEVEL_WARN=y
CONFIG_IEEE802154_ENABLED=y
CONFIG_ESP_MAIN_TASK_STACK_SIZE=4096
```
